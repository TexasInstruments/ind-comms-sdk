/**
 * @cliArgs --device "AM243x_ALV_beta" --package "ALV" --part "ALV" --context "r5fss0-0" --product "INDUSTRIAL_COMMUNICATIONS_SDK@09.02.00"
 * @versions {"tool":"1.20.0+3587"}
 */

/**
 * Import the modules used in this configuration.
 */
const eeprom      = scripting.addModule("/board/eeprom/eeprom", {}, false);
const eeprom1     = eeprom.addInstance();
const flash       = scripting.addModule("/board/flash/flash", {}, false);
const flash1      = flash.addInstance();
const led         = scripting.addModule("/board/led/led", {}, false);
const led1        = led.addInstance();
const led2        = led.addInstance();
const led3        = led.addInstance();
const gpio        = scripting.addModule("/drivers/gpio/gpio", {}, false);
const gpio1       = gpio.addInstance();
const i2c         = scripting.addModule("/drivers/i2c/i2c", {}, false);
const i2c1        = i2c.addInstance();
const i2c2        = i2c.addInstance();
const profinet    = scripting.addModule("/industrial_comms/profinet/profinet", {}, false);
const profinet1   = profinet.addInstance();
const debug_log   = scripting.addModule("/kernel/dpl/debug_log");
const mpu_armv7   = scripting.addModule("/kernel/dpl/mpu_armv7", {}, false);
const mpu_armv71  = mpu_armv7.addInstance();
const mpu_armv72  = mpu_armv7.addInstance();
const mpu_armv73  = mpu_armv7.addInstance();
const mpu_armv74  = mpu_armv7.addInstance();
const mpu_armv75  = mpu_armv7.addInstance();
const mpu_armv76  = mpu_armv7.addInstance();
const mpu_armv77  = mpu_armv7.addInstance();
const mpu_armv78  = mpu_armv7.addInstance();
const mpu_armv79  = mpu_armv7.addInstance();
const mpu_armv710 = mpu_armv7.addInstance();
const mpu_armv711 = mpu_armv7.addInstance();
const mpu_armv712 = mpu_armv7.addInstance();
const mpu_armv713 = mpu_armv7.addInstance();
const mpu_armv714 = mpu_armv7.addInstance();
const timer       = scripting.addModule("/kernel/dpl/timer", {}, false);
const timer1      = timer.addInstance();
const timer2      = timer.addInstance();
const general     = scripting.addModule("/memory_configurator/general", {}, false);
const general1    = general.addInstance();
const region      = scripting.addModule("/memory_configurator/region", {}, false);
const region1     = region.addInstance();
const section     = scripting.addModule("/memory_configurator/section", {}, false);
const section1    = section.addInstance();
const section2    = section.addInstance();
const section3    = section.addInstance();
const section4    = section.addInstance();
const section5    = section.addInstance();
const section6    = section.addInstance();
const section7    = section.addInstance();
const section8    = section.addInstance();
const section9    = section.addInstance();
const section10   = section.addInstance();
const section11   = section.addInstance();
const section12   = section.addInstance();
const section13   = section.addInstance();
const section14   = section.addInstance();

/**
 * Write custom configuration values to the imported modules.
 */
eeprom1.$name = "CONFIG_EEPROM0";

flash1.$name                         = "CONFIG_FLASH0";
flash1.peripheralDriver.$name        = "CONFIG_OSPI0";
flash1.peripheralDriver.inputClkFreq = 166666666;
flash1.peripheralDriver.OSPI.$assign = "OSPI0";

led1.$name = "CONFIG_CYCLIC_LEDS";
led1.name  = "TPIC2810";

led2.$name   = "CONFIG_SYS_FAILURE_LED";
led2.name    = "Ioexp";
led2.ioIndex = 16;

led3.$name = "CONFIG_DCP_SIGNAL_LED";

gpio1.$name                    = "CONFIG_GPIO0_DCP_SIGNAL_LED";
gpio1.pinDir                   = "OUTPUT";
gpio1.useMcuDomainPeripherals  = true;
led3.peripheralDriver          = gpio1;
gpio1.MCU_GPIO.$assign         = "MCU_GPIO0";
gpio1.MCU_GPIO.gpioPin.$assign = "MCU_SPI1_CS0";

i2c1.$name            = "CONFIG_I2C1_STATUS_LEDS";
led1.peripheralDriver = i2c1;
led2.peripheralDriver = i2c1;
i2c1.I2C.$assign      = "I2C1";
i2c1.I2C_child.$name  = "drivers_i2c_v0_i2c_v0_template0";

i2c2.$name               = "CONFIG_I2C0_EEPROM";
eeprom1.peripheralDriver = i2c2;
i2c2.bitRate             = "1P0MHZ";
i2c2.I2C.$assign         = "I2C0";
i2c2.I2C_child.$name     = "drivers_i2c_v0_i2c_v0_template1";

profinet1.$name                       = "CONFIG_PROFINET0";
profinet1.mdioManualModeLinkPolling   = "MLINK";
profinet1.icss_emac[0].$name          = "CONFIG_ICSS_EMAC0";
profinet1.icss_emac[0].txTaskPriority = 28;
profinet1.icss_emac[0].learningEnable = true;
profinet1.icss_emac[0].rxTaskPriority = 28;
profinet1.ethphy1[0].$name            = "CONFIG_ETHPHY0";
profinet1.ethphy1[0].mdioPort         = scripting.forceWrite(15);
profinet1.ethphy2[0].$name            = "CONFIG_ETHPHY1";

const pruicss                            = scripting.addModule("/drivers/pruicss/pruicss", {}, false);
const pruicss1                           = pruicss.addInstance({}, false);
pruicss1.$name                           = "CONFIG_PRU_ICSS1";
profinet1.icss                           = pruicss1;
pruicss1.AdditionalICSSSettings[0].$name = "CONFIG_PRU_ICSS_IO1";

debug_log.enableUartLog        = true;
debug_log.uartLog.$name        = "CONFIG_UART_CONSOLE";
debug_log.uartLog.UART.$assign = "USART0";

const uart_v0_template  = scripting.addModule("/drivers/uart/v0/uart_v0_template", {}, false);
const uart_v0_template1 = uart_v0_template.addInstance({}, false);
uart_v0_template1.$name = "drivers_uart_v0_uart_v0_template0";
debug_log.uartLog.child = uart_v0_template1;

mpu_armv71.$name             = "CONFIG_MPU_REGION0";
mpu_armv71.size              = 31;
mpu_armv71.accessPermissions = "Supervisor RD+WR, User RD";
mpu_armv71.attributes        = "Device";
mpu_armv71.allowExecute      = false;

mpu_armv72.$name             = "CONFIG_MPU_REGION1";
mpu_armv72.size              = 15;
mpu_armv72.accessPermissions = "Supervisor RD+WR, User RD";

mpu_armv73.$name             = "CONFIG_MPU_REGION2";
mpu_armv73.baseAddr          = 0x41010000;
mpu_armv73.size              = 15;
mpu_armv73.accessPermissions = "Supervisor RD+WR, User RD";

mpu_armv74.$name             = "CONFIG_MPU_REGION3_SRAM";
mpu_armv74.baseAddr          = 0x70000000;
mpu_armv74.size              = 21;
mpu_armv74.accessPermissions = "Supervisor RD+WR, User RD";

mpu_armv75.$name      = "CONFIG_MPU_REGION4_DDR";
mpu_armv75.baseAddr   = 0x80000000;
mpu_armv75.size       = 31;
mpu_armv75.attributes = "NonCached";

mpu_armv76.$name    = "CONFIG_MPU_REGION5_DDR_ICSS";
mpu_armv76.baseAddr = 0x80000000;
mpu_armv76.size     = 21;

mpu_armv77.$name      = "CONFIG_MPU_REGION6_DDR_DATA";
mpu_armv77.baseAddr   = 0x80200000;
mpu_armv77.size       = 20;
mpu_armv77.attributes = "NonCached";

mpu_armv78.$name      = "CONFIG_MPU_REGION7_DDR_BSS";
mpu_armv78.baseAddr   = 0x80300000;
mpu_armv78.size       = 20;
mpu_armv78.attributes = "NonCached";

mpu_armv79.$name      = "CONFIG_MPU_REGION8_DDR_PNIP";
mpu_armv79.baseAddr   = 0x80400000;
mpu_armv79.size       = 21;
mpu_armv79.attributes = "NonCached";

mpu_armv710.$name      = "CONFIG_MPU_REGION9_DDR_PERIF";
mpu_armv710.baseAddr   = 0x80600000;
mpu_armv710.size       = 21;
mpu_armv710.attributes = "NonCached";

mpu_armv711.$name      = "CONFIG_MPU_REGION3_DDR_RXTX";
mpu_armv711.baseAddr   = 0x80800000;
mpu_armv711.size       = 21;
mpu_armv711.attributes = "NonCached";

mpu_armv712.$name    = "CONFIG_MPU_REGION3_DDR_HEAP";
mpu_armv712.baseAddr = 0x80C00000;
mpu_armv712.size     = 21;

mpu_armv713.$name      = "CONFIG_MPU_REGION3";
mpu_armv713.baseAddr   = 0x70000000;
mpu_armv713.size       = 16;
mpu_armv713.attributes = "Cached+Sharable";

mpu_armv714.$name        = "CONFIG_MPU_PRU_ICSS";
mpu_armv714.baseAddr     = 0x30080000;
mpu_armv714.size         = 19;
mpu_armv714.attributes   = "Device";
mpu_armv714.allowExecute = false;

timer1.$name         = "CONFIG_TIMER0";
timer1.startTimer    = true;
timer1.timerCallback = "OSAL_FREERTOS_callbackTimer";
timer1.TIMER.$assign = "DMTIMER0";

timer2.$name         = "CONFIG_TIMER1";
timer2.usecPerTick   = 125;
timer2.timerCallback = "PND_EDDP_IrqSendClock";
timer2.TIMER.$assign = "DMTIMER1";

general1.$name           = "CONFIG_GENERAL0";
general1.stack_size      = 4096;
general1.heap_size       = 524288;
general1.additional_data = "\nLINKER_CMD_VAL_START_OF_DATA_MEM = START(DATA_MEM);\nLINKER_CMD_VAL_END_OF_DATA_MEM =   END(DATA_MEM);\nLINKER_CMD_VAL_START_OF_HEAP_MEM = START(HEAP_MEM);\nLINKER_CMD_VAL_END_OF_HEAP_MEM =   END(HEAP_MEM);";
general1.linker.$name    = "TIARMCLANG0";

region1.$name                                = "MEMORY_REGION_CONFIGURATION0";
region1.memory_region.create(12);
region1.memory_region[0].type                = "TCMA_R5F";
region1.memory_region[0].$name               = "R5F_VECS";
region1.memory_region[0].size                = 0x40;
region1.memory_region[0].auto                = false;
region1.memory_region[1].type                = "TCMA_R5F";
region1.memory_region[1].size                = 0x7FC0;
region1.memory_region[1].auto                = false;
region1.memory_region[1].manualStartAddress  = 0x40;
region1.memory_region[1].$name               = "R5F_TCMA";
region1.memory_region[2].type                = "TCMB_R5F";
region1.memory_region[2].$name               = "R5F_TCMB0";
region1.memory_region[2].size                = 0x8000;
region1.memory_region[2].auto                = false;
region1.memory_region[3].size                = 0x10000;
region1.memory_region[3].$name               = "ICSS_PKT_BUF_MEM";
region1.memory_region[3].auto                = false;
region1.memory_region[4].$name               = "HEAP_MEM";
region1.memory_region[4].size                = 0x80000;
region1.memory_region[4].auto                = false;
region1.memory_region[4].manualStartAddress  = 0x70010000;
region1.memory_region[5].auto                = false;
region1.memory_region[5].manualStartAddress  = 0x70090000;
region1.memory_region[5].size                = 0x144000;
region1.memory_region[5].$name               = "MSRAM";
region1.memory_region[6].$name               = "USER_SHM_MEM";
region1.memory_region[6].size                = 0x4000;
region1.memory_region[6].auto                = false;
region1.memory_region[6].manualStartAddress  = 0x701D4000;
region1.memory_region[7].auto                = false;
region1.memory_region[7].manualStartAddress  = 0x701D8000;
region1.memory_region[7].size                = 0x4000;
region1.memory_region[7].$name               = "LOG_SHM_MEM";
region1.memory_region[8].auto                = false;
region1.memory_region[8].size                = 0x4000;
region1.memory_region[8].$name               = "RTOS_NORTOS_IPC_SHM_MEM";
region1.memory_region[8].manualStartAddress  = 0x701DC000;
region1.memory_region[9].type                = "DDR_ALL";
region1.memory_region[9].$name               = "CODE_MEM";
region1.memory_region[9].size                = 0x1D0000;
region1.memory_region[9].auto                = false;
region1.memory_region[10].type               = "DDR_ALL";
region1.memory_region[10].$name              = "BOOT_PKT_MEM";
region1.memory_region[10].auto               = false;
region1.memory_region[10].manualStartAddress = 0x80200000;
region1.memory_region[10].size               = 0x200000;
region1.memory_region[11].type               = "DDR_ALL";
region1.memory_region[11].$name              = "DATA_MEM";
region1.memory_region[11].auto               = false;
region1.memory_region[11].manualStartAddress = 0x80400000;
region1.memory_region[11].size               = 0x200000;

section1.$name                        = "CONFIG_SECTION0";
section1.load_memory                  = "R5F_VECS";
section1.group                        = false;
section1.output_section.create(1);
section1.output_section[0].$name      = ".vectors";
section1.output_section[0].palignment = true;

section2.$name                        = "CONFIG_SECTION1";
section2.group                        = false;
section2.load_memory                  = "R5F_TCMA";
section2.output_section.create(2);
section2.output_section[0].$name      = ".text.hwi";
section2.output_section[0].palignment = true;
section2.output_section[1].$name      = ".text_tcm";
section2.output_section[1].palignment = true;

section3.$name                        = "CONFIG_SECTION2";
section3.load_memory                  = "MSRAM";
section3.output_section.create(3);
section3.output_section[0].$name      = ".ARM.exidx";
section3.output_section[0].palignment = true;
section3.output_section[1].$name      = ".init_array";
section3.output_section[1].palignment = true;
section3.output_section[2].$name      = ".fini_array";
section3.output_section[2].palignment = true;

section4.$name                        = "CONFIG_SECTION3";
section4.load_memory                  = "MSRAM";
section4.output_section.create(3);
section4.output_section[0].$name      = ".text.cache";
section4.output_section[0].palignment = true;
section4.output_section[1].$name      = ".text.mpu";
section4.output_section[1].palignment = true;
section4.output_section[2].$name      = ".text.boot";
section4.output_section[2].palignment = true;

section5.$name                        = "CONFIG_SECTION4";
section5.load_memory                  = "CODE_MEM";
section5.output_section.create(2);
section5.output_section[0].palignment = true;
section5.output_section[0].$name      = ".text";
section5.output_section[1].palignment = true;
section5.output_section[1].$name      = ".rodata";

section6.$name                        = "CONFIG_SECTION5";
section6.load_memory                  = "MSRAM";
section6.output_section.create(3);
section6.output_section[0].$name      = ".data";
section6.output_section[0].palignment = true;
section6.output_section[1].$name      = ".threadstack";
section6.output_section[1].palignment = true;
section6.output_section[2].$name      = ".stack";
section6.output_section[2].palignment = true;

section7.$name                                   = "CONFIG_SECTION6";
section7.load_memory                             = "DATA_MEM";
section7.output_section.create(1);
section7.output_section[0].$name                 = ".bss";
section7.output_section[0].palignment            = true;
section7.output_section[0].output_sections_start = "__BSS_START";
section7.output_section[0].output_sections_end   = "__BSS_END";

section8.$name                                    = "CONFIG_SECTION7";
section8.load_memory                              = "MSRAM";
section8.output_section.create(5);
section8.output_section[0].$name                  = ".irqstack";
section8.output_section[0].output_sections_start  = "__IRQ_STACK_START";
section8.output_section[0].output_sections_end    = "__IRQ_STACK_END";
section8.output_section[0].macro_name             = "IRQSTACK_SECTION";
section8.output_section[0].input_section.create(1);
section8.output_section[0].input_section[0].$name = ". = . + __IRQ_STACK_SIZE;";
section8.output_section[1].$name                  = ".fiqstack";
section8.output_section[1].output_sections_start  = "__FIQ_STACK_START";
section8.output_section[1].output_sections_end    = "__FIQ_STACK_END";
section8.output_section[1].input_section.create(1);
section8.output_section[1].input_section[0].$name = ". = . + __FIQ_STACK_SIZE;";
section8.output_section[2].$name                  = ".svcstack";
section8.output_section[2].output_sections_start  = "__SVC_STACK_START";
section8.output_section[2].output_sections_end    = "__SVC_STACK_END";
section8.output_section[2].input_section.create(1);
section8.output_section[2].input_section[0].$name = ". = . + __SVC_STACK_SIZE;";
section8.output_section[3].$name                  = ".abortstack";
section8.output_section[3].output_sections_start  = "__ABORT_STACK_START";
section8.output_section[3].output_sections_end    = "__ABORT_STACK_END";
section8.output_section[3].input_section.create(1);
section8.output_section[3].input_section[0].$name = ". = . + __ABORT_STACK_SIZE;";
section8.output_section[4].$name                  = ".undefinedstack";
section8.output_section[4].output_sections_start  = "__UNDEFINED_STACK_START";
section8.output_section[4].output_sections_end    = "__UNDEFINED_STACK_END";
section8.output_section[4].input_section.create(1);
section8.output_section[4].input_section[0].$name = ". = . + __UNDEFINED_STACK_SIZE;";

section9.$name                       = "CONFIG_SECTION8";
section9.type                        = "NOLOAD";
section9.group                       = false;
section9.load_memory                 = "ICSS_PKT_BUF_MEM";
section9.output_section.create(1);
section9.output_section[0].$name     = ".bss.icss_emac_pktbuf_mem";
section9.output_section[0].alignment = 0;

section10.$name                       = "CONFIG_SECTION9";
section10.group                       = false;
section10.type                        = "NOLOAD";
section10.load_memory                 = "USER_SHM_MEM";
section10.output_section.create(1);
section10.output_section[0].$name     = ".bss.user_shared_mem";
section10.output_section[0].alignment = 0;

section11.$name                       = "CONFIG_SECTION10";
section11.type                        = "NOLOAD";
section11.load_memory                 = "LOG_SHM_MEM";
section11.group                       = false;
section11.output_section.create(1);
section11.output_section[0].$name     = ".bss.log_shared_mem";
section11.output_section[0].alignment = 0;

section12.$name                       = "CONFIG_SECTION11";
section12.group                       = false;
section12.load_memory                 = "RTOS_NORTOS_IPC_SHM_MEM";
section12.output_section.create(1);
section12.output_section[0].$name     = ".bss.ipc_vring_mem";
section12.output_section[0].alignment = 0;

section13.$name                       = "CONFIG_SECTION12";
section13.group                       = false;
section13.load_memory                 = "HEAP_MEM";
section13.output_section.create(1);
section13.output_section[0].$name     = ".sysmem";
section13.output_section[0].alignment = 0;

section14.$name                       = "CONFIG_SECTION13";
section14.type                        = "NOLOAD";
section14.group                       = false;
section14.load_memory                 = "BOOT_PKT_MEM";
section14.output_section.create(1);
section14.output_section[0].$name     = ".boot_pkt_mem";
section14.output_section[0].alignment = 0;

/**
 * Pinmux solution for unlocked pins/peripherals. This ensures that minor changes to the automatic solver in a future
 * version of the tool will not impact the pinmux you originally saw.  These lines can be completely deleted in order to
 * re-solve from scratch.
 */
flash1.peripheralDriver.OSPI.CLK.$suggestSolution          = "OSPI0_CLK";
flash1.peripheralDriver.OSPI.CSn0.$suggestSolution         = "OSPI0_CSn0";
flash1.peripheralDriver.OSPI.DQS.$suggestSolution          = "OSPI0_DQS";
flash1.peripheralDriver.OSPI.D7.$suggestSolution           = "OSPI0_D7";
flash1.peripheralDriver.OSPI.D6.$suggestSolution           = "OSPI0_D6";
flash1.peripheralDriver.OSPI.D5.$suggestSolution           = "OSPI0_D5";
flash1.peripheralDriver.OSPI.D4.$suggestSolution           = "OSPI0_D4";
flash1.peripheralDriver.OSPI.D3.$suggestSolution           = "OSPI0_D3";
flash1.peripheralDriver.OSPI.D2.$suggestSolution           = "OSPI0_D2";
flash1.peripheralDriver.OSPI.D1.$suggestSolution           = "OSPI0_D1";
flash1.peripheralDriver.OSPI.D0.$suggestSolution           = "OSPI0_D0";
i2c1.I2C.SCL.$suggestSolution                              = "I2C1_SCL";
i2c1.I2C.SDA.$suggestSolution                              = "I2C1_SDA";
i2c2.I2C.SCL.$suggestSolution                              = "I2C0_SCL";
i2c2.I2C.SDA.$suggestSolution                              = "I2C0_SDA";
profinet1.PRU_ICSSG1_MDIO.$suggestSolution                 = "PRU_ICSSG1_MDIO0";
profinet1.PRU_ICSSG1_MDIO.MDC.$suggestSolution             = "PRG1_MDIO0_MDC";
profinet1.PRU_ICSSG1_MDIO.MDIO.$suggestSolution            = "PRG1_MDIO0_MDIO";
profinet1.PRU_ICSSG1_MII_G_RT.$suggestSolution             = "PRU_ICSSG1_MII_G_RT";
profinet1.PRU_ICSSG1_MII_G_RT.MII0_RXD0.$suggestSolution   = "PRG1_PRU0_GPO0";
profinet1.PRU_ICSSG1_MII_G_RT.MII0_RXD1.$suggestSolution   = "PRG1_PRU0_GPO1";
profinet1.PRU_ICSSG1_MII_G_RT.MII0_RXD2.$suggestSolution   = "PRG1_PRU0_GPO2";
profinet1.PRU_ICSSG1_MII_G_RT.MII0_RXD3.$suggestSolution   = "PRG1_PRU0_GPO3";
profinet1.PRU_ICSSG1_MII_G_RT.MII0_RXDV.$suggestSolution   = "PRG1_PRU0_GPO4";
profinet1.PRU_ICSSG1_MII_G_RT.MII0_RXER.$suggestSolution   = "PRG1_PRU0_GPO5";
profinet1.PRU_ICSSG1_MII_G_RT.MII0_TXD0.$suggestSolution   = "PRG1_PRU0_GPO11";
profinet1.PRU_ICSSG1_MII_G_RT.MII0_TXD1.$suggestSolution   = "PRG1_PRU0_GPO12";
profinet1.PRU_ICSSG1_MII_G_RT.MII0_TXD2.$suggestSolution   = "PRG1_PRU0_GPO13";
profinet1.PRU_ICSSG1_MII_G_RT.MII0_TXD3.$suggestSolution   = "PRG1_PRU0_GPO14";
profinet1.PRU_ICSSG1_MII_G_RT.MII0_TXEN.$suggestSolution   = "PRG1_PRU0_GPO15";
profinet1.PRU_ICSSG1_MII_G_RT.MII1_RXD0.$suggestSolution   = "PRG1_PRU1_GPO0";
profinet1.PRU_ICSSG1_MII_G_RT.MII1_RXD1.$suggestSolution   = "PRG1_PRU1_GPO1";
profinet1.PRU_ICSSG1_MII_G_RT.MII1_RXD2.$suggestSolution   = "PRG1_PRU1_GPO2";
profinet1.PRU_ICSSG1_MII_G_RT.MII1_RXD3.$suggestSolution   = "PRG1_PRU1_GPO3";
profinet1.PRU_ICSSG1_MII_G_RT.MII1_RXDV.$suggestSolution   = "PRG1_PRU1_GPO4";
profinet1.PRU_ICSSG1_MII_G_RT.MII1_RXER.$suggestSolution   = "PRG1_PRU1_GPO5";
profinet1.PRU_ICSSG1_MII_G_RT.MII1_TXD0.$suggestSolution   = "PRG1_PRU1_GPO11";
profinet1.PRU_ICSSG1_MII_G_RT.MII1_TXD1.$suggestSolution   = "PRG1_PRU1_GPO12";
profinet1.PRU_ICSSG1_MII_G_RT.MII1_TXD2.$suggestSolution   = "PRG1_PRU1_GPO13";
profinet1.PRU_ICSSG1_MII_G_RT.MII1_TXD3.$suggestSolution   = "PRG1_PRU1_GPO14";
profinet1.PRU_ICSSG1_MII_G_RT.MII1_TXEN.$suggestSolution   = "PRG1_PRU1_GPO15";
profinet1.PRU_ICSSG1_MII_G_RT.MII_MR0_CLK.$suggestSolution = "PRG1_PRU0_GPO6";
profinet1.PRU_ICSSG1_MII_G_RT.MII_MR1_CLK.$suggestSolution = "PRG1_PRU1_GPO6";
profinet1.PRU_ICSSG1_MII_G_RT.MII_MT0_CLK.$suggestSolution = "PRG1_PRU0_GPO16";
profinet1.PRU_ICSSG1_MII_G_RT.MII_MT1_CLK.$suggestSolution = "PRG1_PRU1_GPO16";
profinet1.PRU_ICSSG1_MII_G_RT.MII0_RXLINK.$suggestSolution = "PRG1_PRU0_GPO8";
profinet1.PRU_ICSSG1_MII_G_RT.MII1_RXLINK.$suggestSolution = "PRG1_PRU1_GPO8";
debug_log.uartLog.UART.RXD.$suggestSolution                = "UART0_RXD";
debug_log.uartLog.UART.TXD.$suggestSolution                = "UART0_TXD";
