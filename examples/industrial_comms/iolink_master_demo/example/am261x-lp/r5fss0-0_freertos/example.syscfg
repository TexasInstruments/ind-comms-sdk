/**
 * @cliArgs --device "AM261x_ZFG" --part "AM2612" --package "ZFG" --context "r5fss0-0" --product "INDUSTRIAL_COMMUNICATIONS_SDK_AM261x@10.00.00"
 * @versions {"tool":"1.21.2+3837"}
 */

/**
 * Import the modules used in this configuration.
 */
const eeprom          = scripting.addModule("/board/eeprom/eeprom", {}, false);
const eeprom1         = eeprom.addInstance();
const led             = scripting.addModule("/board/led/led", {}, false);
const led1            = led.addInstance();
const led2            = led.addInstance();
const edma            = scripting.addModule("/drivers/edma/edma", {}, false);
const edma1           = edma.addInstance();
const gpio            = scripting.addModule("/drivers/gpio/gpio", {}, false);
const gpio1           = gpio.addInstance();
const gpio2           = gpio.addInstance();
const gpio3           = gpio.addInstance();
const gpio4           = gpio.addInstance();
const gpio5           = gpio.addInstance();
const gpio6           = gpio.addInstance();
const gpio7           = gpio.addInstance();
const gpio8           = gpio.addInstance();
const gpio9           = gpio.addInstance();
const gpio10          = gpio.addInstance();
const gpio11          = gpio.addInstance();
const gpio12          = gpio.addInstance();
const gpio13          = gpio.addInstance();
const gpio14          = gpio.addInstance();
const gpio15          = gpio.addInstance();
const gpio16          = gpio.addInstance();
const gpio17          = gpio.addInstance();
const gpio18          = gpio.addInstance();
const gpio19          = gpio.addInstance();
const gpio20          = gpio.addInstance();
const gpio21          = gpio.addInstance();
const gpio22          = gpio.addInstance();
const gpio23          = gpio.addInstance();
const gpio24          = gpio.addInstance();
const gpio25          = gpio.addInstance();
const gpio26          = gpio.addInstance();
const gpio27          = gpio.addInstance();
const gpio28          = gpio.addInstance();
const gpio29          = gpio.addInstance();
const gpio30          = gpio.addInstance();
const gpio31          = gpio.addInstance();
const gpio32          = gpio.addInstance();
const gpio33          = gpio.addInstance();
const gpio34          = gpio.addInstance();
const gpio35          = gpio.addInstance();
const gpio36          = gpio.addInstance();
const gpio37          = gpio.addInstance();
const gpio38          = gpio.addInstance();
const gpio39          = gpio.addInstance();
const gpio40          = gpio.addInstance();
const gpio41          = gpio.addInstance();
const gpio42          = gpio.addInstance();
const gpio43          = gpio.addInstance();
const gpio44          = gpio.addInstance();
const i2c             = scripting.addModule("/drivers/i2c/i2c", {}, false);
const i2c1            = i2c.addInstance();
const i2c2            = i2c.addInstance();
const mcspi           = scripting.addModule("/drivers/mcspi/mcspi", {}, false);
const mcspi1          = mcspi.addInstance();
const pruicss         = scripting.addModule("/drivers/pruicss/pruicss", {}, false);
const pruicss1        = pruicss.addInstance();
const uart            = scripting.addModule("/drivers/uart/uart", {}, false);
const uart1           = uart.addInstance();
const clock           = scripting.addModule("/kernel/dpl/clock");
const debug_log       = scripting.addModule("/kernel/dpl/debug_log");
const dpl_cfg         = scripting.addModule("/kernel/dpl/dpl_cfg");
const mpu_armv7       = scripting.addModule("/kernel/dpl/mpu_armv7", {}, false);
const mpu_armv71      = mpu_armv7.addInstance();
const mpu_armv72      = mpu_armv7.addInstance();
const mpu_armv73      = mpu_armv7.addInstance();
const mpu_armv74      = mpu_armv7.addInstance();
const mpu_armv75      = mpu_armv7.addInstance();
const mpu_armv76      = mpu_armv7.addInstance();
const timer           = scripting.addModule("/kernel/dpl/timer", {}, false);
const timer1          = timer.addInstance();
const default_linker  = scripting.addModule("/memory_configurator/default_linker", {}, false);
const default_linker1 = default_linker.addInstance();
const general         = scripting.addModule("/memory_configurator/general", {}, false);
const general1        = general.addInstance();
const region          = scripting.addModule("/memory_configurator/region", {}, false);
const region1         = region.addInstance();
const section         = scripting.addModule("/memory_configurator/section", {}, false);
const section1        = section.addInstance();
const section2        = section.addInstance();
const section3        = section.addInstance();
const section4        = section.addInstance();
const section5        = section.addInstance();
const section6        = section.addInstance();
const section7        = section.addInstance();
const section8        = section.addInstance();
const section9        = section.addInstance();
const section10       = section.addInstance();
const section11       = section.addInstance();
const section12       = section.addInstance();

/**
 * Write custom configuration values to the imported modules.
 */
eeprom1.$name      = "CONFIG_EEPROM0";
eeprom1.i2cAddress = 0x51;

led1.$name      = "CONFIG_LED_DIGITAL_OUTPUT";
led1.name       = "TPIC2810";
led1.i2cAddress = 0x61;

led2.$name = "CONFIG_LED_RUN";

gpio1.$name           = "CONFIG_GPIO0";
gpio1.pinDir          = "OUTPUT";
led2.peripheralDriver = gpio1;
gpio1.GPIO_n.$assign  = "GPIO8";

gpio2.$name          = "CONFIG_GPIO1";
gpio2.pinDir         = "OUTPUT";
gpio2.rx             = true;
gpio2.GPIO_n.$assign = "GPIO9";

gpio3.$name          = "CONFIG_GPIO3";
gpio3.rx             = true;
gpio3.GPIO_n.$assign = "GPIO10";

gpio4.$name          = "CONFIG_IOL_TX1";
gpio4.pinDir         = "OUTPUT";
gpio4.GPIO_n.$assign = "GPIO20";

gpio5.$name          = "CONFIG_IOL_TX2";
gpio5.GPIO_n.$assign = "GPIO74";

gpio6.$name          = "CONFIG_IOL_TX3";
gpio6.pinDir         = "OUTPUT";
gpio6.GPIO_n.$assign = "GPIO125";

gpio7.$name          = "CONFIG_IOL_TX4";
gpio7.pinDir         = "OUTPUT";
gpio7.GPIO_n.$assign = "GPIO123";

gpio8.$name          = "CONFIG_IOL_TX5";
gpio8.pinDir         = "OUTPUT";
gpio8.GPIO_n.$assign = "GPIO18";

gpio9.$name          = "CONFIG_IOL_TX6";
gpio9.pinDir         = "OUTPUT";
gpio9.GPIO_n.$assign = "GPIO17";

gpio10.$name          = "CONFIG_IOL_TX7";
gpio10.pinDir         = "OUTPUT";
gpio10.GPIO_n.$assign = "GPIO4";

gpio11.$name          = "CONFIG_IOL_TX8";
gpio11.pinDir         = "OUTPUT";
gpio11.GPIO_n.$assign = "GPIO3";

gpio12.$name          = "CONFIG_IOL_RX1";
gpio12.GPIO_n.$assign = "GPIO71";

gpio13.$name          = "CONFIG_IOL_RX2";
gpio13.GPIO_n.$assign = "GPIO72";

gpio14.$name          = "CONFIG_IOL_RX3";
gpio14.GPIO_n.$assign = "GPIO73";

gpio15.$name          = "CONFIG_IOL_RX4";
gpio15.GPIO_n.$assign = "GPIO16";

gpio16.$name          = "CONFIG_IOL_RX5";
gpio16.GPIO_n.$assign = "GPIO15";

gpio17.$name                        = "CONFIG_IOL_RX6";
gpio17.GPIO_n.$assignAllowConflicts = "GPIO54";
scripting.suppress("Resource conflict,@@@.+?@@@ is also in use by @@@.+?@@@", gpio17, "GPIO_n");

gpio18.$name          = "CONFIG_IOL_RX7";
gpio18.GPIO_n.$assign = "GPIO19";

gpio19.$name          = "CONFIG_IOL_RX8";
gpio19.GPIO_n.$assign = "GPIO133";

gpio20.$name          = "CONFIG_IOL_TXEN1";
gpio20.pinDir         = "OUTPUT";
gpio20.GPIO_n.$assign = "GPIO126";

gpio21.$name          = "CONFIG_IOL_TXEN2";
gpio21.pinDir         = "OUTPUT";
gpio21.GPIO_n.$assign = "GPIO44";

gpio22.$name          = "CONFIG_IOL_TXEN3";
gpio22.pinDir         = "OUTPUT";
gpio22.GPIO_n.$assign = "GPIO6";

gpio23.$name          = "CONFIG_IOL_TXEN4";
gpio23.pinDir         = "OUTPUT";
gpio23.GPIO_n.$assign = "GPIO5";

gpio24.$name                        = "CONFIG_IOL_TXEN5";
gpio24.pinDir                       = "OUTPUT";
gpio24.GPIO_n.$assignAllowConflicts = "GPIO130";

gpio25.$name          = "CONFIG_IOL_TXEN6";
gpio25.pinDir         = "OUTPUT";
gpio25.GPIO_n.$assign = "GPIO106";

gpio26.$name          = "CONFIG_IOL_TXEN7";
gpio26.pinDir         = "OUTPUT";
gpio26.GPIO_n.$assign = "GPIO90";

gpio27.$name          = "CONFIG_IOL_TXEN8";
gpio27.pinDir         = "OUTPUT";
gpio27.GPIO_n.$assign = "GPIO46";

gpio28.$name          = "CONFIG_IOL_ENL1";
gpio28.pinDir         = "OUTPUT";
gpio28.GPIO_n.$assign = "GPIO25";

gpio29.$name          = "CONFIG_IOL_ENL2";
gpio29.pinDir         = "OUTPUT";
gpio29.GPIO_n.$assign = "GPIO81";

gpio30.$name          = "CONFIG_IOL_ENL3";
gpio30.pinDir         = "OUTPUT";
gpio30.GPIO_n.$assign = "GPIO82";

gpio31.$name          = "CONFIG_IOL_ENL4";
gpio31.pinDir         = "OUTPUT";
gpio31.GPIO_n.$assign = "GPIO83";

gpio32.$name          = "CONFIG_IOL_ENL5";
gpio32.pinDir         = "OUTPUT";
gpio32.GPIO_n.$assign = "GPIO45";

gpio33.$name                        = "CONFIG_IOL_ENL6";
gpio33.pinDir                       = "OUTPUT";
gpio33.GPIO_n.$assignAllowConflicts = "GPIO54";
scripting.suppress("Resource conflict,@@@.+?@@@ is also in use by @@@.+?@@@", gpio33, "GPIO_n");

gpio34.$name          = "CONFIG_IOL_ENL7";
gpio34.pinDir         = "OUTPUT";
gpio34.GPIO_n.$assign = "GPIO26";

gpio35.$name          = "CONFIG_IOL_ENL8";
gpio35.pinDir         = "OUTPUT";
gpio35.GPIO_n.$assign = "GPIO80";

gpio36.pinDir         = "OUTPUT";
gpio36.$name          = "CONFIG_IOL_DI_NLD";
gpio36.GPIO_n.$assign = "GPIO1";

gpio37.$name          = "CONFIG_IOL_FAULT1";
gpio37.GPIO_n.$assign = "GPIO53";

gpio38.$name          = "CONFIG_IOL_FAULT2";
gpio38.GPIO_n.$assign = "GPIO58";

gpio39.$name          = "CONFIG_IOL_FAULT3";
gpio39.GPIO_n.$assign = "GPIO55";

gpio40.$name          = "CONFIG_IOL_FAULT4";
gpio40.GPIO_n.$assign = "GPIO56";

gpio41.$name          = "CONFIG_IOL_FAULT5";
gpio41.GPIO_n.$assign = "GPIO57";

gpio42.$name          = "CONFIG_IOL_FAULT6";
gpio42.GPIO_n.$assign = "GPIO63";

gpio43.$name          = "CONFIG_IOL_FAULT7";
gpio43.GPIO_n.$assign = "GPIO22";

gpio44.$name          = "CONFIG_IOL_FAULT8";
gpio44.GPIO_n.$assign = "GPIO21";

eeprom1.peripheralDriver = i2c1;
i2c1.$name               = "CONFIG_I2C_IOL";
i2c1.I2C.$assign         = "I2C0";
i2c1.I2C.SCL.$assign     = "GPIO135";
i2c1.I2C.SDA.$assign     = "GPIO134";
i2c1.I2C_child.$name     = "drivers_i2c_v1_i2c_v1_template0";

i2c2.$name            = "CONFIG_I2C1";
led1.peripheralDriver = i2c2;
i2c2.I2C.$assign      = "I2C1";
i2c2.I2C.SCL.$assign  = "GPIO23";
i2c2.I2C_child.$name  = "drivers_i2c_v1_i2c_v1_template1";

mcspi1.trMode                       = "RX_ONLY";
mcspi1.intrEnable                   = "POLLED";
mcspi1.$name                        = "CONFIG_MCSPI_IOL";
mcspi1.SPI.$assign                  = "SPI2";
mcspi1.SPI.CLK.$assign              = "GPIO129";
mcspi1.SPI.D0.$assignAllowConflicts = "GPIO130";
mcspi1.SPI.D0.$used                 = false;
mcspi1.SPI.D1.$assign               = "GPIO128";
mcspi1.mcspiChannel[0].$name        = "CONFIG_MCSPI_CH1";
mcspi1.mcspiChannel[0].frameFormat  = "POL1_PHA1";
mcspi1.mcspiChannel[0].CSn.$assign  = "GPIO138";
mcspi1.child.$name                  = "drivers_mcspi_v1_mcspi_v1_template1";

edma1.$name                    = "CONFIG_EDMA0";
mcspi1.edmaDriver              = edma1;
edma1.edmaRmDmaCh[0].$name     = "CONFIG_EDMA_RM0";
edma1.edmaRmQdmaCh[0].$name    = "CONFIG_EDMA_RM1";
edma1.edmaRmQdmaCh[0].endIndex = 1;
edma1.edmaRmTcc[0].$name       = "CONFIG_EDMA_RM2";
edma1.edmaRmParam[0].$name     = "CONFIG_EDMA_RM3";

pruicss1.$name    = "CONFIG_PRU_ICSS1";
pruicss1.instance = "ICSSM1";

uart1.$name            = "CONFIG_UART_SMI";
uart1.readMode         = "CALLBACK";
uart1.readCallbackFxn  = "vUartRxCallback";
uart1.writeMode        = "CALLBACK";
uart1.writeCallbackFxn = "vUartTxCallback";
uart1.UART.$assign     = "UART0";
uart1.UART.RXD.$assign = "GPIO27";
uart1.UART.TXD.$assign = "GPIO28";
uart1.child.$name      = "drivers_uart_v2_uart_v2_template0";

mpu_armv71.$name             = "CONFIG_MPU_REGION0";
mpu_armv71.size              = 31;
mpu_armv71.accessPermissions = "Supervisor RD+WR, User RD";
mpu_armv71.attributes        = "Device";
mpu_armv71.allowExecute      = false;

mpu_armv72.$name             = "CONFIG_MPU_REGION1";
mpu_armv72.size              = 15;
mpu_armv72.accessPermissions = "Supervisor RD+WR, User RD";

mpu_armv73.$name             = "CONFIG_MPU_REGION2";
mpu_armv73.baseAddr          = 0x80000;
mpu_armv73.size              = 15;
mpu_armv73.accessPermissions = "Supervisor RD+WR, User RD";

mpu_armv74.$name             = "CONFIG_MPU_REGION3";
mpu_armv74.baseAddr          = 0x70000000;
mpu_armv74.size              = 21;
mpu_armv74.accessPermissions = "Supervisor RD+WR, User RD";

mpu_armv75.$name        = "CONFIG_MPU_REGION4";
mpu_armv75.baseAddr     = 0x50D00000;
mpu_armv75.size         = 14;
mpu_armv75.attributes   = "Device";
mpu_armv75.allowExecute = false;

mpu_armv76.$name        = "CONFIG_MPU_REGION5";
mpu_armv76.baseAddr     = 0x72000000;
mpu_armv76.size         = 14;
mpu_armv76.attributes   = "NonCached";
mpu_armv76.allowExecute = false;

timer1.$name         = "CONFIG_TIMER0";
timer1.usecPerTick   = 100;
timer1.timerCallback = "OSAL_FREERTOS_callbackTimer";
timer1.startTimer    = true;

default_linker1.$name = "memory_configurator_default_linker0";

general1.$name        = "CONFIG_GENERAL0";
general1.stack_size   = 32768;
general1.linker.$name = "TIARMCLANG0";

region1.$name                                = "MEMORY_REGION_CONFIGURATION0";
region1.memory_region.create(11);
region1.memory_region[0].type                = "TCMA";
region1.memory_region[0].$name               = "R5F_VECS";
region1.memory_region[0].size                = 0x40;
region1.memory_region[0].auto                = false;
region1.memory_region[1].type                = "TCMA";
region1.memory_region[1].$name               = "R5F_TCMA";
region1.memory_region[1].size                = 0x7FC0;
region1.memory_region[2].type                = "TCMB";
region1.memory_region[2].size                = 0x8000;
region1.memory_region[2].$name               = "R5F_TCMB";
region1.memory_region[3].$name               = "SBL";
region1.memory_region[3].auto                = false;
region1.memory_region[3].size                = 0x40000;
region1.memory_region[4].$name               = "OCRAM";
region1.memory_region[4].auto                = false;
region1.memory_region[4].manualStartAddress  = 0x70080000;
region1.memory_region[4].size                = 0x80000;
region1.memory_region[5].type                = "FLASH";
region1.memory_region[5].auto                = false;
region1.memory_region[5].manualStartAddress  = 0x60100000;
region1.memory_region[5].size                = 0x80000;
region1.memory_region[5].$name               = "FLASH";
region1.memory_region[6].$name               = "USER_SHM_MEM";
region1.memory_region[6].auto                = false;
region1.memory_region[6].manualStartAddress  = 0x70150000;
region1.memory_region[6].size                = 0x4000;
region1.memory_region[6].isShared            = true;
region1.memory_region[6].shared_cores        = ["r5fss0-1"];
region1.memory_region[7].$name               = "LOG_SHM_MEM";
region1.memory_region[7].auto                = false;
region1.memory_region[7].manualStartAddress  = 0x70154000;
region1.memory_region[7].size                = 0x4000;
region1.memory_region[7].isShared            = true;
region1.memory_region[7].shared_cores        = ["r5fss0-1"];
region1.memory_region[8].type                = "CUSTOM";
region1.memory_region[8].$name               = "RTOS_NORTOS_IPC_SHM_MEM";
region1.memory_region[8].auto                = false;
region1.memory_region[8].manualStartAddress  = 0x72000000;
region1.memory_region[8].size                = 0x3E80;
region1.memory_region[8].isShared            = true;
region1.memory_region[8].shared_cores        = ["r5fss0-1"];
region1.memory_region[9].type                = "CUSTOM";
region1.memory_region[9].$name               = "MAILBOX_HSM";
region1.memory_region[9].auto                = false;
region1.memory_region[9].manualStartAddress  = 0x44000000;
region1.memory_region[9].size                = 0x3CE;
region1.memory_region[9].isShared            = true;
region1.memory_region[9].shared_cores        = ["r5fss0-1"];
region1.memory_region[10].type               = "CUSTOM";
region1.memory_region[10].$name              = "MAILBOX_R5F";
region1.memory_region[10].auto               = false;
region1.memory_region[10].manualStartAddress = 0x44000400;
region1.memory_region[10].size               = 0x3CE;
region1.memory_region[10].isShared           = true;
region1.memory_region[10].shared_cores       = ["r5fss0-1"];

section1.load_memory                  = "R5F_VECS";
section1.group                        = false;
section1.$name                        = "Vector Table";
section1.output_section.create(1);
section1.output_section[0].$name      = ".vectors";
section1.output_section[0].palignment = true;

section2.load_memory                  = "OCRAM";
section2.$name                        = "Text Segments";
section2.output_section.create(5);
section2.output_section[0].$name      = ".text.hwi";
section2.output_section[0].palignment = true;
section2.output_section[1].$name      = ".text.cache";
section2.output_section[1].palignment = true;
section2.output_section[2].$name      = ".text.mpu";
section2.output_section[2].palignment = true;
section2.output_section[3].$name      = ".text.boot";
section2.output_section[3].palignment = true;
section2.output_section[4].$name      = ".text:abort";
section2.output_section[4].palignment = true;

section3.load_memory                  = "OCRAM";
section3.$name                        = "Code and Read-Only Data";
section3.output_section.create(2);
section3.output_section[0].$name      = ".text";
section3.output_section[0].palignment = true;
section3.output_section[1].$name      = ".rodata";
section3.output_section[1].palignment = true;

section4.load_memory                  = "OCRAM";
section4.$name                        = "Data Segment";
section4.output_section.create(1);
section4.output_section[0].$name      = ".data";
section4.output_section[0].palignment = true;

section5.load_memory                             = "OCRAM";
section5.$name                                   = "Memory Segments";
section5.output_section.create(4);
section5.output_section[0].$name                 = ".bss";
section5.output_section[0].output_sections_start = "__BSS_START";
section5.output_section[0].output_sections_end   = "__BSS_END";
section5.output_section[0].palignment            = true;
section5.output_section[1].$name                 = ".sysmem";
section5.output_section[1].palignment            = true;
section5.output_section[2].$name                 = ".stack";
section5.output_section[2].palignment            = true;
section5.output_section[3].$name                 = ".threadstack";
section5.output_section[3].palignment            = true;

section6.load_memory                              = "OCRAM";
section6.$name                                    = "Stack Segments";
section6.output_section.create(5);
section6.output_section[0].$name                  = ".irqstack";
section6.output_section[0].output_sections_start  = "__IRQ_STACK_START";
section6.output_section[0].output_sections_end    = "__IRQ_STACK_END";
section6.output_section[0].input_section.create(1);
section6.output_section[0].input_section[0].$name = ". = . + __IRQ_STACK_SIZE;";
section6.output_section[1].$name                  = ".fiqstack";
section6.output_section[1].output_sections_start  = "__FIQ_STACK_START";
section6.output_section[1].output_sections_end    = "__FIQ_STACK_END";
section6.output_section[1].input_section.create(1);
section6.output_section[1].input_section[0].$name = ". = . + __FIQ_STACK_SIZE;";
section6.output_section[2].$name                  = ".svcstack";
section6.output_section[2].output_sections_start  = "__SVC_STACK_START";
section6.output_section[2].output_sections_end    = "__SVC_STACK_END";
section6.output_section[2].input_section.create(1);
section6.output_section[2].input_section[0].$name = ". = . + __SVC_STACK_SIZE;";
section6.output_section[3].$name                  = ".abortstack";
section6.output_section[3].output_sections_start  = "__ABORT_STACK_START";
section6.output_section[3].output_sections_end    = "__ABORT_STACK_END";
section6.output_section[3].input_section.create(1);
section6.output_section[3].input_section[0].$name = ". = . + __ABORT_STACK_SIZE;";
section6.output_section[4].$name                  = ".undefinedstack";
section6.output_section[4].output_sections_start  = "__UNDEFINED_STACK_START";
section6.output_section[4].output_sections_end    = "__UNDEFINED_STACK_END";
section6.output_section[4].input_section.create(1);
section6.output_section[4].input_section[0].$name = ". = . + __UNDEFINED_STACK_SIZE;";

section7.load_memory                  = "OCRAM";
section7.$name                        = "Initialization and Exception Handling";
section7.output_section.create(3);
section7.output_section[0].$name      = ".ARM.exidx";
section7.output_section[0].palignment = true;
section7.output_section[1].$name      = ".init_array";
section7.output_section[1].palignment = true;
section7.output_section[2].$name      = ".fini_array";
section7.output_section[2].palignment = true;

section8.load_memory                 = "USER_SHM_MEM";
section8.type                        = "NOLOAD";
section8.$name                       = "User Shared Memory";
section8.group                       = false;
section8.output_section.create(1);
section8.output_section[0].$name     = ".bss.user_shared_mem";
section8.output_section[0].alignment = 0;

section9.load_memory                 = "LOG_SHM_MEM";
section9.$name                       = "Log Shared Memory";
section9.group                       = false;
section9.type                        = "NOLOAD";
section9.output_section.create(1);
section9.output_section[0].$name     = ".bss.log_shared_mem";
section9.output_section[0].alignment = 0;

section10.load_memory                 = "RTOS_NORTOS_IPC_SHM_MEM";
section10.type                        = "NOLOAD";
section10.$name                       = "IPC Shared Memory";
section10.group                       = false;
section10.output_section.create(1);
section10.output_section[0].$name     = ".bss.ipc_vring_mem";
section10.output_section[0].alignment = 0;

section11.load_memory                 = "MAILBOX_HSM";
section11.type                        = "NOLOAD";
section11.$name                       = "SIPC HSM Queue Memory";
section11.group                       = false;
section11.output_section.create(1);
section11.output_section[0].$name     = ".bss.sipc_hsm_queue_mem";
section11.output_section[0].alignment = 0;

section12.load_memory                 = "MAILBOX_R5F";
section12.$name                       = "SIPC R5F Queue Memory";
section12.group                       = false;
section12.type                        = "NOLOAD";
section12.output_section.create(1);
section12.output_section[0].alignment = 0;
section12.output_section[0].$name     = ".bss.sipc_r5f_queue_mem";

/**
 * Pinmux solution for unlocked pins/peripherals. This ensures that minor changes to the automatic solver in a future
 * version of the tool will not impact the pinmux you originally saw.  These lines can be completely deleted in order to
 * re-solve from scratch.
 */
i2c2.I2C.SDA.$suggestSolution = "GPIO24";
timer1.RTI.$suggestSolution   = "RTI1";
